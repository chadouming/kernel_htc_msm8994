## arch/arm64/hotplug/Kconfig
```kconfig
config HIMA_HOTPLUG
        bool "Enable hima-hotplug cpu hotplug driver"
	depends STATE_NOTIFIER
        default n
        help
          Generic cpu hotplugging driver for ARM SOCs
```
